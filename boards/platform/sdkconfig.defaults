## components/panel_common/Kconfig
```kconfig
menu "WebRTC Demo Common"

config NYX_PANEL_BOARD_LCD_X8
   bool "Waveshare ESP32-P4-WIFI6-Touch-LCD-X 8-inch board"
   default n
   depends on IDF_TARGET_ESP32P4 && ESP32P4_REV_MIN_FULL >= 300 && BSP_LCD_TYPE_800_1280_8_INCH_A
   help
      Select the integrated LCD-X8 board wiring: LCD reset on GPIO 27,
      PWM backlight on GPIO 26, ES8311 speaker and ES7210 microphones.
      The default remains the ESP32-P4-Platform with an external DSI LCD.

config NETWORK_USE_ETHERNET
   bool "Network use Ethernet"
   default n
   depends on IDF_TARGET_ESP32P4
   help
      Enable this option to use Ethernet

endmenu
```

## research/wakeword_p4/pocketsphinx_p4_selftest/main/Kconfig.projbuild
```kconfig
menu "Lexical replay"
config NYX_LEXICAL_QEMU_RAM
    bool "Use the ESP32-P4 QEMU memory window for the replay heap"
    default n
endmenu
```

## research/wakeword_p4/pocketsphinx_p4_selftest/sdkconfig.defaults
```kconfig
CONFIG_ESPTOOLPY_FLASHSIZE_16MB=y
CONFIG_PARTITION_TABLE_CUSTOM=y
CONFIG_PARTITION_TABLE_CUSTOM_FILENAME="partitions.csv"
CONFIG_FATFS_LFN_HEAP=y
CONFIG_ESP_MAIN_TASK_STACK_SIZE=32768
CONFIG_NEWLIB_NANO_FORMAT=n
CONFIG_COMPILER_OPTIMIZATION_PERF=y
CONFIG_COMPILER_FLOAT_LIB_FROM_GCCLIB=y
```

## research/wakeword_p4/speex_echo_p4/sdkconfig.defaults
```kconfig
CONFIG_ESPTOOLPY_FLASHSIZE_4MB=y
CONFIG_COMPILER_OPTIMIZATION_PERF=y
CONFIG_COMPILER_FLOAT_LIB_FROM_GCCLIB=y
```
